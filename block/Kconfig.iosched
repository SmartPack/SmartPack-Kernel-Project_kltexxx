## block/Kconfig.iosched
```kconfig
if BLOCK

menu "IO Schedulers"

config IOSCHED_NOOP
	bool
	default y
	---help---
	  The no-op I/O scheduler is a minimal scheduler that does basic merging
	  and sorting. Its main uses include non-disk based block devices like
	  memory devices, and specialised software or hardware environments
	  that do their own scheduling and require only minimal assistance from
	  the kernel.

config IOSCHED_FIFO
	bool
	default y
	---help---
	  Fifo is similar to no-op I/O scheduler and it's a minimal scheduler that does basic merging
	  and sorting. Ported from: https://github.com/AndroidDeveloperAlliance/ZenKernel_TUNA/blob/master/block/fifo-iosched.c

config IOSCHED_FIOPS
	tristate "FIOPS I/O scheduler"
	default y

config IOSCHED_SIOPLUS
	tristate "Simple I/O scheduler plus"
	default y
	---help---
	  The Simple I/O scheduler is an extremely simple scheduler,
	  based on noop and deadline, that relies on deadlines to
	  ensure fairness. The algorithm does not do any sorting but
	  basic merging, trying to keep a minimum overhead. It is aimed
	  mainly for aleatory access devices (eg: flash devices).

config IOSCHED_BFQ
	tristate "BFQ I/O scheduler"
	depends on EXPERIMENTAL
	default n
	---help---
	  The BFQ I/O scheduler tries to distribute bandwidth among
	  all processes according to their weights.
	  It aims at distributing the bandwidth as desired, independently of
	  the disk parameters and with any workload. It also tries to
	  guarantee low latency to interactive and soft real-time
	  applications. If compiled built-in (saying Y here), BFQ can
	  be configured to support hierarchical scheduling.

config CGROUP_BFQIO
	bool "BFQ hierarchical scheduling support"
	depends on CGROUPS && IOSCHED_BFQ=y
	default n
	---help---
	  Enable hierarchical scheduling in BFQ, using the cgroups
	  filesystem interface.  The name of the subsystem will be
	  bfqio.

choice
	prompt "Default I/O scheduler"
	default DEFAULT_CFQ
	help
	  Select the I/O scheduler which will be used by default for all
	  block devices.

	config DEFAULT_NOOP
		bool "No-op"

	config DEFAULT_BFQ
  		bool "BFQ" if IOSCHED_BFQ=y
  		help

	config DEFAULT_FIOPS
		bool "FIOPS" if IOSCHED_FIOPS=y

	config DEFAULT_SIOPLUS
		bool "SIOPLUS" if IOSCHED_SIOPLUS=y

	config DEFAULT_FIFO
		bool "fifo"

endchoice

config DEFAULT_IOSCHED
	string
	default "bfq" if DEFAULT_BFQ
	default "noop" if DEFAULT_NOOP
	default "sioplus" if DEFAULT_SIOPLUS
	default "fifo" if DEFAULT_FIFO
	default "fiops" if DEFAULT_FIOPS

endmenu

endif
```

## drivers/cpufreq/Kconfig
```kconfig
menu "CPU Frequency scaling"

config CPU_FREQ
	bool "CPU Frequency scaling"
	help
	  CPU Frequency scaling allows you to change the clock speed of 
	  CPUs on the fly. This is a nice method to save power, because 
	  the lower the CPU clock speed, the less power the CPU consumes.

	  Note that this driver doesn't automatically change the CPU
	  clock speed, you need to either enable a dynamic cpufreq governor
	  (see below) after boot, or use a userspace tool.

	  For details, take a look at <file:Documentation/cpu-freq>.

	  If in doubt, say N.
config SEC_DVFS
	bool "DVFS job"
	default n
	depends on CPU_FREQ
if CPU_FREQ

config CPU_FREQ_TABLE
	tristate

config CPU_FREQ_STAT
	tristate "CPU frequency translation statistics"
	select CPU_FREQ_TABLE
	default y
	help
	  This driver exports CPU frequency statistics information through sysfs
	  file system.

	  To compile this driver as a module, choose M here: the
	  module will be called cpufreq_stats.

	  If in doubt, say N.

config CPU_FREQ_STAT_DETAILS
	bool "CPU frequency translation statistics details"
	depends on CPU_FREQ_STAT
	help
	  This will show detail CPU frequency translation table in sysfs file
	  system.

	  If in doubt, say N.

config CPU_FREQ_LIMIT
	bool "CPU frequency limit API"
	default n
	help
	  This driver supports API to limit CPU frequency.

choice
	prompt "Default CPUFreq governor"
	default CPU_FREQ_DEFAULT_GOV_USERSPACE if CPU_FREQ_SA1100 || CPU_FREQ_SA1110
	default CPU_FREQ_DEFAULT_GOV_PERFORMANCE
	help
	  This option sets which CPUFreq governor shall be loaded at
	  startup. If in doubt, select 'performance'.

config CPU_FREQ_DEFAULT_GOV_PERFORMANCE
	bool "performance"
	select CPU_FREQ_GOV_PERFORMANCE
	help
	  Use the CPUFreq governor 'performance' as default. This sets
	  the frequency statically to the highest frequency supported by
	  the CPU.

config CPU_FREQ_DEFAULT_GOV_POWERSAVE
	bool "powersave"
	depends on EXPERT
	select CPU_FREQ_GOV_POWERSAVE
	help
	  Use the CPUFreq governor 'powersave' as default. This sets
	  the frequency statically to the lowest frequency supported by
	  the CPU.

config CPU_FREQ_DEFAULT_GOV_USERSPACE
	bool "userspace"
	select CPU_FREQ_GOV_USERSPACE
	help
	  Use the CPUFreq governor 'userspace' as default. This allows
	  you to set the CPU frequency manually or when a userspace 
	  program shall be able to set the CPU dynamically without having
	  to enable the userspace governor manually.

config CPU_FREQ_DEFAULT_GOV_ONDEMAND
	bool "ondemand"
	select CPU_FREQ_GOV_ONDEMAND
	select CPU_FREQ_GOV_PERFORMANCE
	help
	  Use the CPUFreq governor 'ondemand' as default. This allows
	  you to get a full dynamic frequency capable system by simply
	  loading your cpufreq low-level hardware driver.
	  Be aware that not all cpufreq drivers support the ondemand
	  governor. If unsure have a look at the help section of the
	  driver. Fallback governor will be the performance governor.

config CPU_FREQ_DEFAULT_GOV_CONSERVATIVE
	bool "conservative"
	select CPU_FREQ_GOV_CONSERVATIVE
	select CPU_FREQ_GOV_PERFORMANCE
	help
	  Use the CPUFreq governor 'conservative' as default. This allows
	  you to get a full dynamic frequency capable system by simply
	  loading your cpufreq low-level hardware driver.
	  Be aware that not all cpufreq drivers support the conservative
	  governor. If unsure have a look at the help section of the
	  driver. Fallback governor will be the performance governor.

config CPU_FREQ_DEFAULT_GOV_INTERACTIVE
	bool "interactive"
	select CPU_FREQ_GOV_INTERACTIVE
	help
	  Use the CPUFreq governor 'interactive' as default. This allows
	  you to get a full dynamic cpu frequency capable system by simply
	  loading your cpufreq low-level hardware driver, using the
	  'interactive' governor for latency-sensitive workloads.

config CPU_FREQ_DEFAULT_GOV_ZZMOOVE
	  bool "zzmoove"
	  select CPU_FREQ_GOV_ZZMOOVE
	  select CPU_FREQ_GOV_PERFORMANCE
	  help
	  Use the CPUFreq governor 'zzmoove' as default, using predefined
	  frequency lookup tables and optimized scaling triggers instead of
	  % frequency steps to get smooth up/downscaling dependant on CPU load.

config CPU_FREQ_DEFAULT_GOV_INTELLIACTIVE
	bool "intelliactive"
	select CPU_FREQ_GOV_INTELLIACTIVE
	help
	  Use the CPUFreq governor 'intelliactive' as default. This allows
	  you to get a full dynamic cpu frequency capable system by simply
	  loading your cpufreq low-level hardware driver, using the
	  'interactive' governor for latency-sensitive workloads.

config CPU_FREQ_DEFAULT_GOV_INTELLIDEMAND

	bool "intellidemand"
	select CPU_FREQ_GOV_INTELLIDEMAND
	help
	  Use the CPUFreq governor 'intellidemand' as default.

config CPU_FREQ_DEFAULT_GOV_ALUCARD
  	bool "alucard"
  	select CPU_FREQ_GOV_ALUCARD
  	help

config CPU_FREQ_DEFAULT_GOV_NIGHTMARE
	bool "nightmare"
	select CPU_FREQ_GOV_NIGHTMARE
	help

config CPU_FREQ_DEFAULT_GOV_WHEATLEY
	bool "wheatley"
	select CPU_FREQ_GOV_WHEATLEY
	select CPU_FREQ_GOV_PERFORMANCE
	---help---
	  Use the CPUFreq governor 'wheatley' as default.

config CPU_FREQ_DEFAULT_GOV_SMARTMAX
        bool "smartmax"
        select CPU_FREQ_GOV_SMARTMAX
        help
          Use the CPUFreq governor 'smartmax' as default

config CPU_FREQ_DEFAULT_GOV_LIONHEART
            bool "lionheart"
            select CPU_FREQ_GOV_LIONHEART
            help
              Use the CPUFreq governor 'lionheart' as default.

config CPU_FREQ_DEFAULT_GOV_ADAPTIVE
	bool "adaptive"
	select CPU_FREQ_GOV_ADAPTIVE
	---help---
	  Use the CPUFreq governor 'adaptive' as default. This allows
	  you to get a full dynamic cpu frequency capable system by simply
	  loading your cpufreq low-level hardware driver, using the
	  'adaptive' governor for latency-sensitive workloads and demanding
	  performance.

config CPU_FREQ_DEFAULT_GOV_BLU_ACTIVE
	bool "blu_active"
	select CPU_FREQ_GOV_BLU_ACTIVE
	help
	  Use the CPUFreq governor 'blu_active' as default. This allows
	  you to get a full dynamic cpu frequency capable system by simply
	  loading your cpufreq low-level hardware driver, using the
	  'interactive' governor for latency-sensitive workloads.

config CPU_FREQ_DEFAULT_GOV_ONDEMANDPLUS
	bool "ondemandplus"
	select CPU_FREQ_GOV_ONDEMANDPLUS
	help
	Use the CPUFreq governor 'ondemandplus' as default.

endchoice

config CPU_FREQ_GOV_PERFORMANCE
	tristate "'performance' governor"
	help
	  This cpufreq governor sets the frequency statically to the
	  highest available CPU frequency.

	  To compile this driver as a module, choose M here: the
	  module will be called cpufreq_performance.

	  If in doubt, say Y.

config CPU_FREQ_GOV_POWERSAVE
	tristate "'powersave' governor"
	help
	  This cpufreq governor sets the frequency statically to the
	  lowest available CPU frequency.

	  To compile this driver as a module, choose M here: the
	  module will be called cpufreq_powersave.

	  If in doubt, say Y.

config CPU_FREQ_GOV_USERSPACE
	tristate "'userspace' governor for userspace frequency scaling"
	help
	  Enable this cpufreq governor when you either want to set the
	  CPU frequency manually or when a userspace program shall
	  be able to set the CPU dynamically, like on LART 
	  <http://www.lartmaker.nl/>.

	  To compile this driver as a module, choose M here: the
	  module will be called cpufreq_userspace.

	  For details, take a look at <file:Documentation/cpu-freq/>.

	  If in doubt, say Y.

config CPU_FREQ_GOV_ONDEMAND
	tristate "'ondemand' cpufreq policy governor"
	select CPU_FREQ_TABLE
	help
	  'ondemand' - This driver adds a dynamic cpufreq policy governor.
	  The governor does a periodic polling and 
	  changes frequency based on the CPU utilization.
	  The support for this governor depends on CPU capability to
	  do fast frequency switching (i.e, very low latency frequency
	  transitions). 

	  To compile this driver as a module, choose M here: the
	  module will be called cpufreq_ondemand.

	  For details, take a look at linux/Documentation/cpu-freq.

	  If in doubt, say N.

config CPU_FREQ_GOV_INTERACTIVE
	tristate "'interactive' cpufreq policy governor"
	help
	  'interactive' - This driver adds a dynamic cpufreq policy governor
	  designed for latency-sensitive workloads.

	  This governor attempts to reduce the latency of clock
	  increases so that the system is more responsive to
	  interactive workloads.

	  To compile this driver as a module, choose M here: the
	  module will be called cpufreq_interactive.

	  For details, take a look at linux/Documentation/cpu-freq.

	  If in doubt, say N.

config CPU_FREQ_GOV_CONSERVATIVE
	tristate "'conservative' cpufreq governor"
	depends on CPU_FREQ
	help
	  'conservative' - this driver is rather similar to the 'ondemand'
	  governor both in its source code and its purpose, the difference is
	  its optimisation for better suitability in a battery powered
	  environment.  The frequency is gracefully increased and decreased
	  rather than jumping to 100% when speed is required.

	  If you have a desktop machine then you should really be considering
	  the 'ondemand' governor instead, however if you are using a laptop,
	  PDA or even an AMD64 based computer (due to the unacceptable
	  step-by-step latency issues between the minimum and maximum frequency
	  transitions in the CPU) you will probably want to use this governor.

	  To compile this driver as a module, choose M here: the
	  module will be called cpufreq_conservative.

	  For details, take a look at linux/Documentation/cpu-freq.

	  If in doubt, say N.

config CPU_FREQ_GOV_ZZMOOVE
	tristate "'zzmoove' cpufreq governor"
	depends on CPU_FREQ
	default y
	help
	  'zzmoove' - based on cpufreq_conservative, using predefined
	  frequency lookup tables and optimized scaling triggers instead of
	  % frequency steps to get smooth up/downscaling dependant on CPU load.
	  If in doubt, say N.

config CPU_FREQ_GOV_INTELLIACTIVE
	tristate "'intelliactive' cpufreq policy governor"
	default y
	help
	  'intelliactive' - This driver adds a dynamic cpufreq policy governor
	  designed for latency-sensitive workloads.

	  This governor attempts to reduce the latency of clock
	  increases so that the system is more responsive to
	  interactive workloads.

	  To compile this driver as a module, choose M here: the
	  module will be called cpufreq_interactive.

	  For details, take a look at linux/Documentation/cpu-freq.

	  If in doubt, say N.

config CPU_FREQ_GOV_INTELLIDEMAND
    tristate "'intellidemand' cpufreq governor"
    depends on CPU_FREQ
	default y

config CPU_FREQ_GOV_ALUCARD
	tristate "'alucard' cpufreq governor"
	depends on CPU_FREQ
	default y
	help

config CPU_FREQ_GOV_NIGHTMARE
	tristate "'nightmare' cpufreq governor"
	depends on CPU_FREQ
	default y
	help

config CPU_FREQ_GOV_WHEATLEY
	tristate "'wheatley' cpufreq governor"
	depends on CPU_FREQ
	default y
	help	

config CPU_FREQ_GOV_SMARTMAX
	tristate "'smartmax' cpufreq policy governor"
	select CPU_FREQ_TABLE
	default y
	help
          'smartmax' combined ondemand and smartass2

config CPU_FREQ_GOV_LIONHEART
	tristate "'lionheart' cpufreq governor"
	depends on CPU_FREQ
	default y
	help
             lionheart' - a "smart" optimized governor!
             If in doubt, say N.

config CPU_FREQ_GOV_ADAPTIVE
	tristate "'adaptive' cpufreq policy governor"
	default y
	help
	  'adaptive' - This driver adds a dynamic cpufreq policy governor
	  designed for latency-sensitive workloads and also for demanding
	  performance.

	  This governor attempts to reduce the latency of clock
	  increases so that the system is more responsive to
	  interactive workloads in loweset steady-state but to
	  to reduce power consumption in middle operation level level up
	  will be done in step by step to prohibit system from going to
	  max operation level.

	  To compile this driver as a module, choose M here: the
	  module will be called cpufreq_adaptive.

	  For details, take a look at linux/Documentation/cpu-freq.

	  If in doubt, say N.

config CPU_FREQ_GOV_BLU_ACTIVE
	tristate "'blu_active' cpufreq policy governor"
	default y
	help
	  'blu_active' - This driver adds a dynamic cpufreq policy governor
	  designed for latency-sensitive workloads.

	  This governor attempts to reduce the latency of clock
	  increases so that the system is more responsive to
	  interactive workloads.

	  To compile this driver as a module, choose M here: the
	  module will be called cpufreq_blu_active.

	  If in doubt, say N.

config CPU_FREQ_GOV_ONDEMANDPLUS
	tristate "'ondemandplus' cpufreq governor"
	depends on CPU_FREQ
	default y	

config CPU_INPUT_BOOST
	bool "CPU Input Boost"
	default y
	help
	  Boosts the CPU on touchscreen and touchpad input. Boost frequencies and
	  durations are calculated automatically.

menu "x86 CPU frequency scaling drivers"
depends on X86
source "drivers/cpufreq/Kconfig.x86"
endmenu

menu "ARM CPU frequency scaling drivers"
depends on ARM
source "drivers/cpufreq/Kconfig.arm"
endmenu

menu "PowerPC CPU frequency scaling drivers"
depends on PPC32 || PPC64
source "drivers/cpufreq/Kconfig.powerpc"
endmenu

config LAZYPLUG
	bool "Conservative hotplugging for generic devices"
	default y
	help
	  This enables the conservative hotplugging, lazyplug by arter97
	  based on intelli_plug. Refer to the comments for more info.

endif
endmenu
```
